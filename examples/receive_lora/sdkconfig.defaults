## test/test_app/components/sx127x/Kconfig
```kconfig
menu "sx127x"
    config SX127X_DISABLE_SPI_CACHE
        bool "Disable SPI cache"
        help
            Disable SPI cache to reduce memory footprint at a cost of longer SPI communication
    config SX127X_MAX_PACKET_SIZE
        int "Max packet size"
        default 2047
        help
            Expected max packet size. Used to initialize internal buffer. Can be fine-tuned to reduce memory footprint.
endmenu
```
